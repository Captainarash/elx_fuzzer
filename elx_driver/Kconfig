## elx_driver/Kconfig
```kconfig
#
# ELX Fuzzer Driver
#

menuconfig ELX_FUZZER
	tristate "ELX Fuzzer support"
	default y
	help
	1. Fuzz the higher exception code easily. This means that the values
	 must be controlled from userspace without further modification of
	the driver and recompilation.

	2. Be flexible, meaning that letting you use any garbage value for
	testing and at the same time, protect kernel from panicing.
	Any crash (hopefully) must be from higher exception levels.

	3. Provide logging and tracking so user can understand what happened
	and provide feedback in order to mutate the inputs.
```
